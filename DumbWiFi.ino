

bool wordFound = false;
unsigned long previousTimeHi = 0;
unsigned long previousTimeHey = 0;
const unsigned long intervalHi = 15000;  // 10 seconds
const unsigned long intervalHey = 5000;  // 5 seconds

#include <ESP8266WiFi.h>       
#include <Adafruit_NeoPixel.h>
#include <Wire.h>
#include "SH1106Wire.h"
#include "OLEDDisplayUi.h"

#include "nuggs.h" // Nugget Face bitmap files

Adafruit_NeoPixel pixels {1, D8, NEO_GRB + NEO_KHZ800 }; // initialize 1 NeoPixel on D8

SH1106Wire display(0x3c, D2, D1); // initialize OLED on I2C pins
OLEDDisplayUi ui     ( &display );
extern "C" {
#include "user_interface.h"
  typedef void (*freedom_outside_cb_t)(uint8 status);
  int wifi_register_send_pkt_freedom_cb(freedom_outside_cb_t cb);
  void wifi_unregister_send_pkt_freedom_cb(void);
  int wifi_send_pkt_freedom(uint8 *buf, int len, bool sys_seq);
}

uint8_t packet0[] = {
  0x80, 0x00, 0x00, 0x00, 0xff, 0xff, 0xff,
  0xff, 0xff, 0xff, 0xda, 0xf1, 0x5b, 0x0c, 0xe2,
  0xff, 0xda, 0xf1, 0x5b, 0x0c, 0xe2, 0xff, 0xd0,
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  0x02, 0x01, 0x00, 0x00, 0x0f, 0xac, 0x02, 0x00,
  0x00 
};

uint8_t packet1[] = {
  0x08, 0x02, 0x3a, 0x01, 0xbc, 0xdd, 0xc2,
  0xb2, 0xc0, 0xab, 0xda, 0xf1, 0x5b, 0x0c, 0xe2,
  0xff, 0xda, 0xf1, 0x5b, 0x0c, 0xe2, 0xff, 0x00,
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  0x00, 0x00, 0x00, 0x00
};

uint8_t packet2[] = {
  0x08, 0x01, 0x3a, 0x01, 0xda, 0xf1, 0x5b,
  0x0c, 0xe2, 0xff, 0xbc, 0xdd, 0xc2, 0xb2, 0xc0,
  0xab, 0xda, 0xf1, 0x5b, 0x0c, 0xe2, 0xff, 0x00,
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  0x00, 0x00
};

uint8_t packet3[] = { 
  0x08, 0x02, 0x3a, 0x01, 0xbc, 0xdd, 0xc2,
  0xb2, 0xc0, 0xab, 0xda, 0xf1, 0x5b, 0x0c, 0xe2,
  0xff, 0xda, 0xf1, 0x5b, 0x0c, 0xe2, 0xff, 0x10,
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  0x06, 0x9c, 0x9c, 0x43
};
uint8_t packet4[] = {
  0x08, 0x01, 0x3a, 0x01, 0xda, 0xf1, 0x5b,
  0x0c, 0xe2, 0xff, 0xbc, 0xdd, 0xc2, 0xb2, 0xc0,
  0xab, 0xda, 0xf1, 0x5b, 0x0c, 0xe2, 0xff, 0x10,
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  0x2d, 0x00, 0x00, 0x00
};

void setup() {
  Serial.begin(115200);           // initialize serial communication
  pixels.begin(); pixels.clear(); // initialize NeoPixel
  ui.setTargetFPS(60); ui.init(); // initialize OLED screen
   

  Serial.println("\ngithub.com/WR117H/DeauthDetector");
  
  // start WiFi
  WiFi.mode(WIFI_OFF);
  wifi_set_opmode(STATION_MODE);

  // set channel
  wifi_set_channel(11);

  display.clear();
  display.flipScreenVertically();
  pixels.setPixelColor(0, pixels.Color(0, 150, 0)); pixels.show();
  displayDeadNugg();

}

void loop() {
  unsigned long currentTime = millis();



  if (Serial.available() > 0) {
    String input = Serial.readStringUntil('\n'); // Read the incoming data until a newline character is encountered
    
    if (input.indexOf("ausfahrt") != -1) { // Check if the specific word is in the input
      wordFound=true;
      
    }
  }
  if (wordFound){
    displayWinnerNugg();
  }
  else{
    int i=0;
    i += wifi_send_pkt_freedom(packet0, sizeof(packet0), 0);
    delay(100);
    i += wifi_send_pkt_freedom(packet1, sizeof(packet1), 0);
    delay(100);
    i += wifi_send_pkt_freedom(packet2, sizeof(packet2), 0);
    delay(100);
    i += wifi_send_pkt_freedom(packet3, sizeof(packet3), 0);
    delay(100);
    i += wifi_send_pkt_freedom(packet4, sizeof(packet4), 0);
    delay(100);
    if (currentTime - previousTimeHey >= intervalHey) {
      displayAliveNugg();
      previousTimeHey = currentTime;
    }
    if (currentTime - previousTimeHi >= intervalHi) {
      displayDeadNugg();
      previousTimeHi = currentTime;
    }  
  }



}
void displayDeadNugg() {
  display.clear();
  display.setFont(DejaVu_Sans_Mono_10);
  display.drawString(0,17,"Sending");
  display.drawString(0,27,"Handshakes");
  
  

  display.drawLine(0, 54, 128, 54);
  display.drawLine(0, 53, 127, 53);
  
  display.drawXbm(0, 0, alive_nugg_width, alive_nugg_height, dead_nugg);
  display.drawString(0,54,"Developed by WR117H");
  display.display();
}
void displayAliveNugg() {
  display.clear();
  display.setFont(DejaVu_Sans_Mono_10);
  display.drawString(0,17,"Enter psswd");
  display.drawString(0,27,"To pass the");
  display.drawString(0,37,"Challenge.");
  

  display.drawLine(0, 54, 128, 54);
  display.drawLine(0, 53, 127, 53);
  
  display.drawXbm(0, 0, alive_nugg_width, alive_nugg_height, dead_nugg);
  display.drawString(0,54,"Developed by WR117H");
  display.display();
}  
void displayWinnerNugg() {
  display.clear();
  display.setFont(DejaVu_Sans_Mono_10);
  display.drawString(0,17,"Congrats");
  display.drawString(0,27,"You Won!!!");

  

  display.drawLine(0, 54, 128, 54);
  display.drawLine(0, 53, 127, 53);
  
  display.drawXbm(0, 0, alive_nugg_width, alive_nugg_height, alive_nugg);
  display.drawString(0,54,"Developed by WR117H");
  display.display();
}
